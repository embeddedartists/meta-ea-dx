## conf/layer.conf
```bitbake
# We have a conf and classes directory, add to BBPATH
BBPATH .= ":${LAYERDIR}"

# We have recipes-* directories, add to BBFILES
BBFILES += "${LAYERDIR}/recipes-*/*/*.bb \
            ${LAYERDIR}/recipes-*/*/*.bbappend"

BBFILE_COLLECTIONS += "meta-ea-dx"
BBFILE_PATTERN_meta-ea-dx = "^${LAYERDIR}/"
BBFILE_PRIORITY_meta-ea-dx = "6"

LAYERSERIES_COMPAT_meta-ea-dx = "mickledore scarthgap styhead walnascar"
```
